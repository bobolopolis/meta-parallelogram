## conf/distro/include/lto-parallelogram.inc
```bitbake
# Some packages are not compatible with LTO, disable it where needed. This
# is in addition to the settings in the lto.inc file in oe-core.

LTO:pn-go = ""
LTO:pn-valgrind = ""
```

## conf/distro/include/lto.inc
```bitbake
# Include this file in a distro to enable link-time optimization. Some
# packages are not compatible with LTO, disable it where needed.

LTO:pn-alsa-lib = ""
LTO:pn-apache2 = ""
LTO:pn-apitrace = ""
LTO:pn-apr = ""
LTO:pn-avahi = ""
LTO:pn-avro-c = ""
LTO:pn-binutils = ""
LTO:pn-brotli = ""
LTO:pn-busybox = ""
LTO:pn-capnproto = ""
LTO:pn-cdrkit = ""
LTO:pn-cjson = ""
LTO:pn-cmake = ""
LTO:pn-curl = ""
LTO:pn-dbus-glib = ""
LTO:pn-doxygen = ""
LTO:pn-edac-utils = ""
LTO:pn-elfutils = ""
LTO:pn-exiv2 = ""
LTO:pn-fmt = ""
LTO:pn-function2 = ""
LTO:pn-fwts = ""
LTO:pn-gammu = ""
LTO:pn-gcc-runtime = ""
LTO:pn-gconf = ""
LTO:pn-gettext = ""
LTO:pn-glibc = ""
LTO:pn-gnutls = ""
LTO:pn-go-runtime = ""
LTO:pn-gperftools = ""
LTO:pn-hdf5 = ""
LTO:pn-heaptrack = ""
LTO:pn-jansson = ""
LTO:pn-jq = ""
LTO:pn-ledmon = ""
LTO:pn-libaio = ""
LTO:pn-libatasmart = ""
LTO:pn-libbsd = ""
LTO:pn-libdvdread = ""
LTO:pn-libfastjson = ""
LTO:pn-libgcc = ""
LTO:pn-libgcc-initial = ""
LTO:pn-libiio = ""
LTO:pn-liblogging = ""
LTO:pn-libmbim = ""
LTO:pn-libnfc = ""
LTO:pn-libnice = ""
LTO:pn-liboauth = ""
LTO:pn-libpipeline = ""
LTO:pn-libproxy = ""
LTO:pn-librelp = ""
LTO:pn-libsolv = ""
LTO:pn-libssh2 = ""
LTO:pn-libtool = ""
LTO:pn-libxcrypt = ""
LTO:pn-lmbench = ""
LTO:pn-ltrace = ""
LTO:pn-mariadb = ""
LTO:pn-modemmanager = ""
LTO:pn-neon = ""
LTO:pn-opensc = ""
LTO:pn-perl = ""
LTO:pn-php = ""
LTO:pn-pkgconf = ""
LTO:pn-pmdk = ""
LTO:pn-portaudio-v19 = ""
LTO:pn-psqlodbc = ""
LTO:pn-pulseaudio = ""
LTO:pn-python3-dbus = ""
LTO:pn-rabbitmq-c = ""
LTO:pn-redis-plus-plus = ""
LTO:pn-satyr = ""
LTO:pn-soci = ""
LTO:pn-telepathy-glib = ""
LTO:pn-thrift = ""
LTO:pn-uftrace = ""
LTO:pn-upower = ""
LTO:pn-valgrind = ""
LTO:pn-wavpack = ""
LTO:pn-yajl = ""
LTO:pn-zbar = ""
LTO:pn-zeromq = ""

LTO ?= "-flto"

SELECTED_OPTIMIZATION:append:class-target = " ${LTO}"
SELECTED_OPTIMIZATION[vardeps] += "LTO"
TARGET_LDFLAGS:append:class-target = " ${LTO}"
```

## conf/distro/parallelogram.conf
```bitbake
DISTRO = "parallelogram"
DISTRO_NAME = "Parallelogram (Red Rectangle Container Distro)"
DISTRO_VERSION = "20220501"
DISTRO_CODENAME = "maroon"
SDK_VENDOR = "-parallelogramsdk"
SDK_VERSION = "${@d.getVar('DISTRO_VERSION').replace('snapshot-${DATE}', 'snapshot')}"

MAINTAINER = "Robert Joslyn <robert.joslyn@redrectangle.org>"

# clang build expects one of -poky, -oe, or -wrs
TARGET_VENDOR = "-oe"

LOCALCONF_VERSION = "1"

DISTRO_FEATURES ?= " \
    acl \
    ipv4 \
    ipv6 \
    largefile \
    lto \
    multiarch \
    ptest \
    xattr \
"

NO_RECOMMENDATIONS = "1"
PACKAGE_FEED_URIS = "https://redrectangle.org"
PACKAGE_FEED_BASE_PATHS = "parallelogram/${DISTRO_VERSION}"

VIRTUAL-RUNTIME_dev_manager ?= ""
VIRTUAL-RUNTIME_login-manager ?= ""
VIRTUAL-RUNTIME_init_manager ?= ""
VIRTUAL-RUNTIME_initscripts ?= ""
VIRTUAL-RUNTIME_keymaps ?= ""

SDK_NAME = "${DISTRO}-${TCLIBC}-${SDKMACHINE}-${IMAGE_BASENAME}-${TUNE_PKGARCH}-${MACHINE}"
SDKPATH = "/opt/${DISTRO}/${SDK_VERSION}"

TCLIBCAPPEND = ""

SANITY_TESTED_DISTROS ?= " \
            poky-3.3 \n \
            poky-3.4 \n \
            ubuntu-16.04 \n \
            ubuntu-18.04 \n \
            ubuntu-20.04 \n \
            ubuntu-21.10 \n \
            fedora-34 \n \
            fedora-35 \n \
            centos-7 \n \
            centos-8 \n \
            debian-9 \n \
            debian-10 \n \
            debian-11 \n \
            opensuseleap-15.3 \n \
            almalinux-8.5 \n \
            "
# add poky sanity bbclass
INHERIT += "poky-sanity"

# QA check settings - a little stricter than the OE-Core defaults
# (none currently necessary as we now match OE-Core)
#WARN_TO_ERROR_QA = "X"
#WARN_QA_remove = "${WARN_TO_ERROR_QA}"
#ERROR_QA_append = " ${WARN_TO_ERROR_QA}"

require conf/distro/include/poky-world-exclude.inc
require conf/distro/include/no-static-libs.inc
require conf/distro/include/yocto-uninative.inc
require conf/distro/include/security_flags.inc
require conf/distro/include/lto.inc
INHERIT += "uninative"

BB_SIGNATURE_HANDLER ?= "OEEquivHash"
BB_HASHSERVE ??= "auto"
```

## conf/layer.conf
```bitbake
# We have a conf and classes directory, add to BBPATH
BBPATH .= ":${LAYERDIR}"

# We have recipes-* directories, add to BBFILES
BBFILES += "${LAYERDIR}/recipes-*/*/*.bb \
            ${LAYERDIR}/recipes-*/*/*.bbappend"

BBFILE_COLLECTIONS += "meta-parallelogram"
BBFILE_PATTERN_meta-parallelogram = "^${LAYERDIR}/"
BBFILE_PRIORITY_meta-parallelogram = "6"

LAYERDEPENDS_meta-parallelogram = "core"
LAYERSERIES_COMPAT_meta-parallelogram = "gatesgarth"
```

## conf/machine/include/tune-paratunex64.inc
```bitbake
# Generic x86-64 tune for parallelogram

DEFAULTTUNE ?= "paratunex64"

# Include the previous tune to pull in PACKAGE_EXTRA_ARCHS
require conf/machine/include/x86/tune-core2.inc

# Extra tune features
TUNEVALID[paratunex64] = "Enable generic processor optimizations"
TUNE_CCARGS .= "${@bb.utils.contains('TUNE_FEATURES', 'paratunex64', ' -march=x86-64 -mmmx -msse -msse2 -msse3 -mssse3', '', d)}"

# Extra tune selections
AVAILTUNES += "paratunex64"
TUNE_FEATURES:tune-paratunex64 = "${TUNE_FEATURES:tune-x86-64} paratunex64"
BASE_LIB:tune-paratunex64 = "lib64"
TUNE_PKGARCH:tune-paratunex64 = "paratunex64"
PACKAGE_EXTRA_ARCHS:tune-paratunex64 = "${PACKAGE_EXTRA_ARCHS:tune-core2-64} paratunex64"
QEMU_EXTRAOPTIONS:paratunex64 = " -cpu Nehalem,check=false"
```

## conf/machine/include/tune-redx86.inc
```bitbake
# Compile settings for an x86 container. Enables additional instruction
# sets via -march to target most modern CPUs made in the last 10-15 years.

DEFAULTTUNE ?= "redx86-64"

# Include the previous tune to pull in PACKAGE_EXTRA_ARCHS
require conf/machine/include/tune-core2.inc

# Extra tune features
TUNEVALID[redx86] = "Enable parallelogram container specific processor optimizations"
TUNE_CCARGS .= "${@bb.utils.contains('TUNE_FEATURES', 'redx86', ' -march=x86-64 -mtune=generic -mfpmath=sse -mmmx -msse -msse2 -msse3 -mssse3', '', d)}"

# Extra tune selections
AVAILTUNES += "redx86-64"
TUNE_FEATURES_tune-redx86-64 = "${TUNE_FEATURES_tune-x86-64} redx86"
BASE_LIB_tune-redx86-64 = "lib64"
TUNE_PKGARCH_tune-redx86-64 = "redx86-64"
PACKAGE_EXTRA_ARCHS_tune-redx86-64 = "${PACKAGE_EXTRA_ARCHS_tune-core2-64} redx86-64"
QEMU_EXTRAOPTIONS_tune-redx86-64 = " -cpu SandyBridge,check=false"
```

## conf/machine/include/tune-x86-64-psabi.inc
```bitbake
# Compile settings for x86-64 psABI levels.
#
# The psABI defines four levels. Each level includes the instructions from
# all lower levels.
# x86-64: CMOV CX8 FPU FXSR MMX FXSR SCE SSE SSE2
# x86-64-v2: CMPXCHG16B LAHF-SAHF POPCNT SSE3 SSE4 SSE4.1 SSE4.2 SSSE3
# x86-64-v3: AVX AVX2 BMI1 BMI2 F16C FMA LZCNT MOVBE XSAVE
# x86-64-v4: AVX512F AVX512BW AVX512CD AVX512DQ AVX512VL

DEFAULTTUNE ?= "x86-64-v2"

# Include the previous tune to pull in PACKAGE_EXTRA_ARCHS
require conf/machine/include/x86/tune-core2.inc

# Extra tune features
TUNEVALID[x86-64-v2] = "Enable x86-64-v2 psABI specific processor optimizations"
TUNE_CCARGS .= "${@bb.utils.contains('TUNE_FEATURES', 'x86-64-v2', ' -march=x86-64-v2', '', d)}"

# Extra tune selections
AVAILTUNES += "x86-64-v2"
TUNE_FEATURES:tune-x86-64-v2 = "${TUNE_FEATURES:tune-x86-64} x86-64-v2"
BASE_LIB:tune-x86-64-v2 = "lib64"
TUNE_PKGARCH:tune-x86-64-v2 = "x86-64-v2"
PACKAGE_EXTRA_ARCHS:tune-x86-64-v2 = "${PACKAGE_EXTRA_ARCHS:tune-core2-64} x86-64-v2"
QEMU_EXTRAOPTIONS:x86-64-v2 = " -cpu Haswell,check=false"


TUNEVALID[x86-64-v3] = "Enable x86-64-v3 psABI specific processor optimizations"
TUNE_CCARGS .= "${@bb.utils.contains('TUNE_FEATURES', 'x86-64-v3', ' -march=x86-64-v3', '', d)}"
AVAILTUNES += "x86-64-v3"
TUNE_FEATURES:tune-x86-64-v3 = "${TUNE_FEATURES:tune-x86-64} x86-64-v3"
BASE_LIB:tune-x86-64-v3 = "lib64"
TUNE_PKGARCH:tune-x86-64-v3 = "x86-64-v3"
PACKAGE_EXTRA_ARCHS:tune-x86-64-v3 = "${PACKAGE_EXTRA_ARCHS:tune-core2-64} x86-64-v3"
QEMU_EXTRAOPTIONS:x86-64-v3 = " -cpu Haswell,check=false"

TUNEVALID[x86-64-v4] = "Enable x86-64-v4 psABI specific processor optimizations"
TUNE_CCARGS .= "${@bb.utils.contains('TUNE_FEATURES', 'x86-64-v4', ' -march=x86-64-v4', '', d)}"
AVAILTUNES += "x86-64-v4"
TUNE_FEATURES:tune-x86-64-v4 = "${TUNE_FEATURES:tune-x86-64} x86-64-v4"
BASE_LIB:tune-x86-64-v4 = "lib64"
TUNE_PKGARCH:tune-x86-64-v4 = "x86-64-v4"
PACKAGE_EXTRA_ARCHS:tune-x86-64-v4 = "${PACKAGE_EXTRA_ARCHS:tune-core2-64} x86-64-v4"
QEMU_EXTRAOPTIONS:x86-64-v4 = " -cpu Skylake-Server,check=false"
```

## conf/machine/parallelogram-arm64.conf
```bitbake
#@TYPE: Machine
#@NAME: parallelogram arm64
#@DESCRIPTION: Machine configuration for parallelogram arm64 machines

DEFAULTTUNE ?= "armv8a-crc"

require conf/machine/include/arm/arch-armv8a.inc

PREFERRED_PROVIDER_virtual/kernel ?= "linux-dummy"
PREFERRED_PROVIDER_virtual/xserver ?= "xserver-xorg"
XSERVER ?= ""

GLIBC_ADDONS = "nptl"

IMAGE_FSTYPES = "container"
QB_SYSTEM_NAME = "qemu-system-arm64"
```

## conf/machine/parallelogramx86-64.conf
```bitbake
#@TYPE: Machine
#@NAME: parallelogram x86-64
#@DESCRIPTION: Machine configuration for parallelogram x86-64 machines

DEFAULTTUNE ?= "paratunex64"
require conf/machine/include/tune-paratunex64.inc

include conf/machine/include/x86/x86-base.inc
require conf/machine/include/x86/qemuboot-x86.inc

PREFERRED_PROVIDER_virtual/kernel ?= "linux-dummy"
PREFERRED_PROVIDER_virtual/xserver ?= "xserver-xorg"
XSERVER ?= ""

GLIBC_ADDONS = "nptl"

IMAGE_FSTYPES = "container"
QB_SYSTEM_NAME = "qemu-system-x86_64"
```

## conf/machine/redcontainerx86-64.conf
```bitbake
#@TYPE: Machine
#@NAME: red container x86-64
#@DESCRIPTION: Machine configuration for red container x86-64 machines

DEFAULTTUNE ?= "redx86-64"
require conf/machine/include/tune-redx86.inc

include conf/machine/include/x86-base.inc
require conf/machine/include/qemuboot-x86.inc

PREFERRED_PROVIDER_virtual/kernel ?= "linux-dummy"
PREFERRED_PROVIDER_virtual/xserver ?= "xserver-xorg"
XSERVER ?= ""

GLIBC_ADDONS = "nptl"

IMAGE_FSTYPES = "container"
QB_SYSTEM_NAME = "qemu-system-x86_64"
```
